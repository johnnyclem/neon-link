## components/ableton_link/Kconfig
```kconfig
menu "NEON LINK — Ableton Link"

config NEON_LINK_STUB
    bool "Build with Link stub (no Ableton Link networking)"
    default n
    help
        Replaces the Ableton Link session with a free-running internal
        timeline (fixed tempo, no peers). Used as a CI fallback leg and
        for debugging: everything downstream of the timeline snapshot
        behaves identically.

config NEON_LINK_AUDIO
    bool "Link Audio streaming (needs Ableton Link 4.0)"
    depends on !NEON_LINK_STUB && !NEON_SYNC
    default y if NEON_AUDIO
    default n
    help
        Publish the module's mix (and line input) as named Link Audio
        channels, and play a channel published by Live 12.4 or another
        peer. Requires the Ableton Link submodule checked out at tag
        Link-4.0 — ableton::LinkAudio does not exist before that, and the
        build fails with a message telling you so.

        With this off, everything downstream still builds and runs: the
        Link Audio facade is a no-op whose available() is false, and the
        editor says streaming is not in this firmware.

endmenu
```

## components/neon_sync_esp/Kconfig
```kconfig
menu "NEON LINK — Neon Sync"

config NEON_SYNC
    bool "Use Neon Sync (Link-free session protocol) instead of Ableton Link"
    default n
    depends on !NEON_LINK_STUB
    help
        Replaces the Ableton Link session with Neon Sync, our own
        leaderless session protocol (docs/NEON_SYNC.md): same
        hal::ILinkSession seam, same downstream behavior, no GPL
        dependency in the image. Peers discover each other over UDP
        multicast (239.77.83.78:20809), agree on tempo/phase/transport
        last-writer-wins, and discipline clocks via NTP-style ping/pong —
        or via the AP's TSF beacon clock when two peers share a BSS.

        Neon Sync peers do not interoperate with Ableton Link peers on
        the wire; Live is bridged via MIDI clock or the VST3 plugin.

endmenu
```

## sdkconfig.defaults.linksync-tab5
```kconfig
# link-sync on M5Stack Tab5 (ESP32-P4 MIPI-DSI 720×1280 + C6 SDIO).
# Isolated build — does not overwrite S3 / CrowPanel sdkconfig:
#   ./scripts/flash_linksync-tab5.sh
# See docs/LINKSYNC_TAB5.md.

CONFIG_IDF_TARGET="esp32p4"
CONFIG_NEON_BOARD_LINKSYNC_TAB5=y
# CONFIG_NEON_BOARD_CUSTOM is not set
# CONFIG_NEON_BOARD_AMYBOARD is not set
# CONFIG_NEON_BOARD_P4DEVKIT is not set
# CONFIG_NEON_BOARD_LINKSYNC is not set
# CONFIG_NEON_BOARD_LINKSYNC_EPD is not set
# CONFIG_NEON_BOARD_LINKSYNC_P4LCD is not set
# CONFIG_NEON_AUDIO is not set

CONFIG_ESP32P4_SELECTS_REV_LESS_V3=y
CONFIG_ESP32P4_REV_MIN_1=y

CONFIG_ESPTOOLPY_FLASHSIZE_16MB=y
CONFIG_ESPTOOLPY_FLASHSIZE="16MB"
CONFIG_ESPTOOLPY_FLASHFREQ_80M=y
CONFIG_ESPTOOLPY_FLASHFREQ="80m"
CONFIG_PARTITION_TABLE_CUSTOM_FILENAME="partitions_16mb.csv"

# In-package 32 MB PSRAM on P4NRW32 is HEX (same die as CrowPanel).
CONFIG_IDF_EXPERIMENTAL_FEATURES=y
CONFIG_SPIRAM=y
CONFIG_SPIRAM_MODE_HEX=y
CONFIG_SPIRAM_SPEED_200M=y
CONFIG_SPIRAM_USE_MALLOC=y
CONFIG_SPIRAM_MALLOC_ALWAYSINTERNAL=4096
CONFIG_SPIRAM_MALLOC_RESERVE_INTERNAL=32768

# Native USB JTAG/serial on the Type-C.
CONFIG_ESP_CONSOLE_USB_SERIAL_JTAG=y
# CONFIG_ESP_CONSOLE_UART_DEFAULT is not set

CONFIG_UART_ISR_IN_IRAM=y

# CONFIG_ETH_USE_ESP32_EMAC is not set

# C6 over SDIO — Tab5 map (not CrowPanel 49–54 / RST 20).
# CONFIG_ESP_HOST_WIFI_ENABLED is not set
CONFIG_SLAVE_IDF_TARGET_ESP32C6=y
CONFIG_WIFI_RMT_CACHE_TX_BUFFER_NUM=32
CONFIG_ESP_HOSTED_ENABLED=y
CONFIG_ESP_HOSTED_SDIO_HOST_INTERFACE=y
CONFIG_ESP_HOSTED_IDF_SLAVE_TARGET="esp32c6"
CONFIG_ESP_HOSTED_SDIO_RESET_ACTIVE_HIGH=y
CONFIG_ESP_HOSTED_SDIO_4_BIT_BUS=y
CONFIG_ESP_HOSTED_SDIO_CLOCK_FREQ_KHZ=40000
CONFIG_ESP_HOSTED_SDIO_GPIO_RESET_SLAVE=15
CONFIG_ESP_HOSTED_SDIO_PIN_CMD=13
CONFIG_ESP_HOSTED_SDIO_PIN_CLK=12
CONFIG_ESP_HOSTED_SDIO_PIN_D0=11
CONFIG_ESP_HOSTED_SDIO_PRIV_PIN_D1_4BIT_BUS=10
CONFIG_ESP_HOSTED_SDIO_PIN_D2=9
CONFIG_ESP_HOSTED_SDIO_PIN_D3=8
CONFIG_ESP_HOSTED_SDIO_PIN_D1=10

# CONFIG_BT_ENABLED is not set
# CONFIG_BT_NIMBLE_ENABLED is not set
# CONFIG_ESP_COEX_SW_COEXIST_ENABLE is not set
```

## test_files/sdkconfig.defaults
```kconfig
CONFIG_PARTITION_TABLE_CUSTOM=y
CONFIG_PARTITION_TABLE_CUSTOM_FILENAME="partitions.csv"
CONFIG_ESPTOOLPY_FLASHSIZE_16MB=y

CONFIG_SPIRAM=y
CONFIG_SPIRAM_USE_MALLOC=y
CONFIG_SPIRAM_MALLOC_ALWAYSINTERNAL=1024

CONFIG_FREERTOS_HZ=1000
CONFIG_ESP_TASK_WDT_EN=n
CONFIG_COMPILER_OPTIMIZATION_PERF=y
```

## tools/a2_sdio_jitter/sdkconfig.defaults
```kconfig
CONFIG_PARTITION_TABLE_CUSTOM=y
CONFIG_PARTITION_TABLE_CUSTOM_FILENAME="partitions.csv"
CONFIG_ESPTOOLPY_FLASHSIZE_16MB=y

CONFIG_SPIRAM=y
CONFIG_SPIRAM_USE_MALLOC=y
CONFIG_SPIRAM_MALLOC_ALWAYSINTERNAL=1024

CONFIG_FREERTOS_HZ=1000
CONFIG_ESP_TASK_WDT_EN=n
CONFIG_COMPILER_OPTIMIZATION_PERF=y

# C6 via Hosted. ESP_HOST_WIFI_ENABLED disables wifi_remote — leave it off.
# CONFIG_ESP_HOST_WIFI_ENABLED is not set
CONFIG_SLAVE_IDF_TARGET_ESP32C6=y
CONFIG_WIFI_RMT_CACHE_TX_BUFFER_NUM=32
# CONFIG_BT_ENABLED is not set
# CONFIG_BT_NIMBLE_ENABLED is not set
# CONFIG_ESP_COEX_SW_COEXIST_ENABLE is not set
```

## tools/a2_sdio_jitter/sdkconfig.defaults.esp32p4
```kconfig
# Waveshare P4-DEV-KIT rev v1.3 — IDF 5.3.2
CONFIG_ESP32P4_REV_MIN_1=y
CONFIG_ESP_DEFAULT_CPU_FREQ_MHZ_360=y

CONFIG_ESPTOOLPY_FLASHSIZE_16MB=y
CONFIG_ESPTOOLPY_FLASHFREQ_80M=y

CONFIG_SPIRAM=y
CONFIG_SPIRAM_MODE_HEX=y
CONFIG_IDF_EXPERIMENTAL_FEATURES=y
CONFIG_SPIRAM_SPEED_200M=y
# CONFIG_SPIRAM_SPEED_20M is not set
CONFIG_SPIRAM_USE_MALLOC=y

CONFIG_ESP_CONSOLE_UART_DEFAULT=y
# CONFIG_ESP_CONSOLE_USB_SERIAL_JTAG is not set
```

## tools/a2_sdio_jitter/sdkconfig.defaults.esp32p4v31
```kconfig
# P4 rev v3.1 / eco6 — IDF 5.5+
# CONFIG_ESP32P4_SELECTS_REV_LESS_V3 is not set
CONFIG_ESP32P4_REV_MIN_301=y
CONFIG_ESP_DEFAULT_CPU_FREQ_MHZ_360=y

CONFIG_ESPTOOLPY_FLASHSIZE_16MB=y
CONFIG_ESPTOOLPY_FLASHFREQ_80M=y

CONFIG_SPIRAM=y
CONFIG_SPIRAM_MODE_HEX=y
CONFIG_SPIRAM_SPEED_200M=y
# CONFIG_SPIRAM_SPEED_20M is not set
CONFIG_SPIRAM_USE_MALLOC=y

CONFIG_ESP_CONSOLE_UART_DEFAULT=y
# CONFIG_ESP_CONSOLE_USB_SERIAL_JTAG is not set
```
